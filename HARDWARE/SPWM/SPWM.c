/**
 * @file    SPWM.c
 * @brief   SPWM模块实现 - 基于TIM1高级定时器的正弦PWM (备用方案)
 * @note    当前项目实际使用 time.c 中基于TIM5的SPWM实现
 *          此模块为独立升级方案:
 *          - 使用TIM1高级定时器 (支持互补输出+死区控制)
 *          - 定点数相位累加器 (Q24格式)
 *          - 调节率 m = V_out * 2*sqrt(2) / V_dc
 *          - 频率增量 = F_out * N * 2^Q / F_carrier
 *
 *          启用以太方案时需:
 *          1. 在main.c中调用 SPWM_Init() 替代当前的PWM5_Init
 *          2. 在TIM7 ISR中调用 SPWM_Update() 替代当前的SPWM计算
 */

#include "stm32f4xx.h"
#include "SPWM.h"

/* ========== 正弦查找表 (400点, 对应50Hz基频) ========== */
/* 中心值1800, 幅值±1350 (对应调制范围0~3150) */
u16 sinData[TABLE_SIZE] = {
    1800,1821,1842,1863,1884,1905,1927,1948,1969,1990,2011,2032,2052,2073,2094,2115,
    2135,2156,2176,2196,2217,2237,2257,2277,2296,2316,2336,2355,2374,2393,2412,2431,
    2450,2468,2487,2505,2523,2541,2558,2576,2593,2610,2627,2644,2660,2676,2692,2708,
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    1464,1484,1505,1526,1547,1567,1588,1609,1630,1651,1672,1694,1715,1736,1757,1778
};

/* ========== 内部控制变量 ========== */
static u32 phase_accumulator = 0;    // 相位累加器 (Q24格式)
static u32 phase_increment = 0;      // 相位增量
static u16 inverter_duty = 1000;     // 调制深度 (0~1000, 对应0~100%)

/**
 * @brief  初始化SPWM (默认50Hz / 220Vrms)
 */
void SPWM_Init(void)
{
    SPWM_SetFrequency(50);
    SPWM_SetVoltage(220);
    phase_accumulator = 0;
}

/**
 * @brief  设置输出电压 (Vrms)
 * @param  voltage_V: 目标电压有效值 (0~230V)
 * @note   调制比 m = V_out * 2*sqrt(2) / V_dc
 */
void SPWM_SetVoltage(u16 voltage_V)
{
    if (voltage_V > 230) voltage_V = 230;

    float modulation = (voltage_V * 2.828f) / DC_BUS_VOLTAGE;
    if (modulation > 1.0f) modulation = 1.0f;

    inverter_duty = (u16)(modulation * 1000.0f);
}

/**
 * @brief  设置输出频率 (Hz)
 * @param  freq_Hz: 目标频率 (1~400Hz)
 * @note   相位增量 = F_out * N * 2^Q / F_carrier
 */
void SPWM_SetFrequency(u16 freq_Hz)
{
    if (freq_Hz > 400) freq_Hz = 400;
    if (freq_Hz < 1) freq_Hz = 1;

    uint64_t temp = (uint64_t)freq_Hz * TABLE_SIZE * FREQ_SCALE;
    phase_increment = (uint32_t)(temp / CARRIER_FREQ);
}

/**
 * @brief  SPWM更新 (需在PWM中断中周期调用)
 * @note   使用TIM1 CH1输出SPWM
 *         启用前需在main.c中初始化PWM1
 */
void SPWM_Update(void)
{
    phase_accumulator += phase_increment;

    u32 index = (phase_accumulator >> Q_SHIFT) % TABLE_SIZE;

    u16 pwm_value = (uint16_t)((sinData[index] - 1800) * inverter_duty / 1000 + 1800);
    TIM_SetCompare1(TIM1, pwm_value);
}
